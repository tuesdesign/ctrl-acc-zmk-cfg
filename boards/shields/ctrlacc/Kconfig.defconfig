## boards/shields/ctrlacc/Kconfig.defconfig
```kconfig
if SHIELD_CTRLACC

# Name must be less than 16 characters long!
config ZMK_KEYBOARD_NAME
    default "Tues CTRL-ACC"

endif

CONFIG_ZMK_STUDIO=y
```
